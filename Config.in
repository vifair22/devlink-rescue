## Config.in
```kconfig
source "$BR2_EXTERNAL_DEVLINK_RESCUE_PATH/package/cabextract/Config.in"
source "$BR2_EXTERNAL_DEVLINK_RESCUE_PATH/package/chntpw/Config.in"
source "$BR2_EXTERNAL_DEVLINK_RESCUE_PATH/package/devlink-agent/Config.in"
source "$BR2_EXTERNAL_DEVLINK_RESCUE_PATH/package/falcon-mkstick32/Config.in"
source "$BR2_EXTERNAL_DEVLINK_RESCUE_PATH/package/fatresize/Config.in"
source "$BR2_EXTERNAL_DEVLINK_RESCUE_PATH/package/ms-sys/Config.in"
source "$BR2_EXTERNAL_DEVLINK_RESCUE_PATH/package/testdisk/Config.in"
```

## package/cabextract/Config.in
```kconfig
config BR2_PACKAGE_CABEXTRACT
	bool "cabextract"
	help
	  Extracts Microsoft cabinet files: the Windows 9x registry
	  backups (RB00x.CAB, holding SYSTEM.DAT and USER.DAT) and the
	  driver and setup CABs of the era, without another machine.

	  https://www.cabextract.org.uk
```

## package/chntpw/Config.in
```kconfig
config BR2_PACKAGE_CHNTPW
	bool "chntpw"
	help
	  Offline editing of Windows NT registry hives and SAM: chntpw,
	  reged, sampasswd and samusrgrp. Built without DOCRYPTO, so it
	  resets (blanks) passwords rather than setting new ones, and
	  needs no OpenSSL.

	  https://pogostick.net/~pnh/ntpasswd/
```

## package/devlink-agent/Config.in
```kconfig
config BR2_PACKAGE_DEVLINK_AGENT
	bool "devlink-agent"
	depends on BR2_USE_MMU # fork
	help
	  The devlink agent for Linux: serves a devlink client over a
	  serial line, so a session on another machine can run commands
	  and move files here. Built static from the devlink source.

	  https://git.airies.net/vifair22/devlink
```

## package/falcon-mkstick32/Config.in
```kconfig
config BR2_PACKAGE_FALCON_MKSTICK32
	bool "falcon-mkstick32"
	help
	  falcon-boot's mkstick, built static for a 32-bit machine:
	  installs, checks and removes falcon station-legacy on a disk
	  (`station install --bios --legacy`), so a machine that cannot
	  boot a 64-bit Linux can have the station put on its own disk
	  from DevLink recovery. The station's files come from the disk
	  or card it runs from, not from this binary.

	  https://git.airies.net/vifair22/falcon-boot
```

## package/fatresize/Config.in
```kconfig
config BR2_PACKAGE_FATRESIZE
	bool "fatresize"
	depends on BR2_PACKAGE_PARTED
	help
	  Resizes a FAT16 or FAT32 file system in place, through
	  libparted: the FAT counterpart of ntfsresize and resize2fs.

	  https://github.com/ya-mouse/fatresize
```

## package/ms-sys/Config.in
```kconfig
config BR2_PACKAGE_MS_SYS
	bool "ms-sys"
	help
	  Writes Microsoft-compatible master boot records and FAT boot
	  records: the 95B/98/ME and 2000/XP MBRs, FAT16/FAT32 DOS boot
	  records and FAT32 NT5 boot records. It has no NT5 NTFS boot
	  record; restore that from the volume's own backup copy.

	  https://ms-sys.sourceforge.net/
```

## package/testdisk/Config.in
```kconfig
config BR2_PACKAGE_TESTDISK
	bool "testdisk"
	depends on BR2_USE_MMU # fork()
	select BR2_PACKAGE_NCURSES
	select BR2_PACKAGE_E2FSPROGS
	select BR2_PACKAGE_NTFS_3G
	select BR2_PACKAGE_ZLIB
	select BR2_PACKAGE_UTIL_LINUX
	select BR2_PACKAGE_UTIL_LINUX_LIBUUID
	help
	  TestDisk finds lost partitions and rewrites a partition table
	  or boot sector; PhotoRec, built with it, carves files out of a
	  disk or image whose file system is gone. Text interface.

	  https://www.cgsecurity.org/wiki/TestDisk
```
